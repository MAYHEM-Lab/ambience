IRQ(POWER_CLOCK_IRQHandler)
IRQ(RADIO_IRQHandler)
IRQ(UARTE0_UART0_IRQHandler)
IRQ(SPIM0_SPIS0_TWIM0_TWIS0_SPI0_TWI0_IRQHandler)
IRQ(SPIM1_SPIS1_TWIM1_TWIS1_SPI1_TWI1_IRQHandler)
IRQ(NFCT_IRQHandler)
IRQ(GPIOTE_IRQHandler)
IRQ(SAADC_IRQHandler)
IRQ(TIMER0_IRQHandler)
IRQ(TIMER1_IRQHandler)
IRQ(TIMER2_IRQHandler)
IRQ(RTC0_IRQHandler)
IRQ(TEMP_IRQHandler)
IRQ(RNG_IRQHandler)
IRQ(ECB_IRQHandler)
IRQ(CCM_AAR_IRQHandler)
IRQ(WDT_IRQHandler)
IRQ(RTC1_IRQHandler)
IRQ(QDEC_IRQHandler)
IRQ(COMP_LPCOMP_IRQHandler)
IRQ(SWI0_EGU0_IRQHandler)
IRQ(SWI1_EGU1_IRQHandler)
IRQ(SWI2_EGU2_IRQHandler)
IRQ(SWI3_EGU3_IRQHandler)
IRQ(SWI4_EGU4_IRQHandler)
IRQ(SWI5_EGU5_IRQHandler)
IRQ(TIMER3_IRQHandler)
IRQ(TIMER4_IRQHandler)
IRQ(PWM0_IRQHandler)
IRQ(PDM_IRQHandler)
IRQ(RESERVED0_IRQHandler)
IRQ(RESERVED1_IRQHandler)
IRQ(MWU_IRQHandler)
IRQ(PWM1_IRQHandler)
IRQ(PWM2_IRQHandler)
IRQ(SPIM2_SPIS2_SPI2_IRQHandler)
IRQ(RTC2_IRQHandler)
IRQ(I2S_IRQHandler)
IRQ(FPU_IRQHandler)
IRQ(USBD_IRQHandler)
IRQ(UARTE1_IRQHandler)
IRQ(QSPI_IRQHandler)
IRQ(CryptoCell_Handler)
