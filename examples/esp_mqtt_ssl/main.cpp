//
// Created by fatih on 7/19/18.
//

#include <tos/print.hpp>

#include <arch/drivers.hpp>
#include <tos/version.hpp>
#include <tos/fixed_fifo.hpp>

#include <lwip/init.h>
#include <algorithm>
#include <common/inet/tcp_stream.hpp>
#include <MQTTClient.h>
#include <tos/adapters.hpp>
#include <stdio.h>

#include <cwpack.hpp>
#include <common/adxl345.hpp>
#include <bearssl.h>
#include <lwip_sntp/sntp.h>

#include "monotonic_clock.hpp"
#include <inttypes.h>
#include <string>

static tos::fixed_fifo<sntp_res_t, 127> vecs;

template <class T>
int handle_samples(MQTT::Client<T, timer_facade, 512> &client) {
    MQTT::Message message;
    message.qos = MQTT::QOS1;
    message.retained = false;
    message.dup = false;

    auto tm = vecs.pop();
    auto buf = "{ \"ts\" : " + std::string(tos::itoa(tm.sntp_time, 10)) + " }";

    message.payload = buf.data();
    message.payloadlen = buf.size();

    auto res = client.publish("tos/time", message);

    return res;
}

br_ssl_client_context sc;
br_x509_minimal_context xc;
unsigned char iobuf[BR_SSL_BUFSIZE_MONO];
br_sslio_context ioc;

using tcp_ptr = tos::tcp_stream<tos::esp82::tcp_endpoint>*;
/*
 * Low-level data read callback for the simplified SSL I/O API.
 */
static int
sock_read(void *ctx, unsigned char *buf, size_t len)
{
    auto ptr = static_cast<tcp_ptr>(ctx);
    for (;;) {
        auto res = ptr->read({ (char*)buf, len });

        if (!res)
        {
            return -1;
        }

        auto r = force_get(res);

        if (r.empty())
        {
            continue;
        }

        return r.size();
    }
}

/*
 * Low-level data write callback for the simplified SSL I/O API.
 */
static int
sock_write(void *ctx, const unsigned char *buf, size_t len)
{
    tos::this_thread::yield();
    auto ptr = static_cast<tcp_ptr>(ctx);
    if (ptr->disconnected())
        return -1;
    return ptr->write({ (const char*)buf, len });
}

extern "C" void optimistic_yield(uint32_t){
    static uint32_t last_yield = 0;
    if (system_get_time() - last_yield > 1'000'000  || last_yield == 0)
    {
        tos_debug_print("yielding\n");
        system_soft_wdt_feed();
        tos::this_thread::yield();
        last_yield = system_get_time();
    }
}

static const unsigned char TA0_DN[] = {
    0x30, 0x39, 0x31, 0x0B, 0x30, 0x09, 0x06, 0x03, 0x55, 0x04, 0x06, 0x13,
    0x02, 0x55, 0x53, 0x31, 0x0F, 0x30, 0x0D, 0x06, 0x03, 0x55, 0x04, 0x0A,
    0x13, 0x06, 0x41, 0x6D, 0x61, 0x7A, 0x6F, 0x6E, 0x31, 0x19, 0x30, 0x17,
    0x06, 0x03, 0x55, 0x04, 0x03, 0x13, 0x10, 0x41, 0x6D, 0x61, 0x7A, 0x6F,
    0x6E, 0x20, 0x52, 0x6F, 0x6F, 0x74, 0x20, 0x43, 0x41, 0x20, 0x31
};

static const unsigned char TA0_RSA_N[] = {
    0xB2, 0x78, 0x80, 0x71, 0xCA, 0x78, 0xD5, 0xE3, 0x71, 0xAF, 0x47, 0x80,
    0x50, 0x74, 0x7D, 0x6E, 0xD8, 0xD7, 0x88, 0x76, 0xF4, 0x99, 0x68, 0xF7,
    0x58, 0x21, 0x60, 0xF9, 0x74, 0x84, 0x01, 0x2F, 0xAC, 0x02, 0x2D, 0x86,
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    0x9A, 0xC8, 0xAA, 0x0D
};

static const unsigned char TA0_RSA_E[] = {
    0x01, 0x00, 0x01
};

static const br_x509_trust_anchor TAs[1] = {
    {
        { (unsigned char *)TA0_DN, sizeof TA0_DN },
        BR_X509_TA_CA,
        {
            BR_KEYTYPE_RSA,
            { .rsa = {
                (unsigned char *)TA0_RSA_N, sizeof TA0_RSA_N,
                (unsigned char *)TA0_RSA_E, sizeof TA0_RSA_E,
            } }
        }
    }
};

static const unsigned char CERT0[] = {
    0x30, 0x82, 0x03, 0x59, 0x30, 0x82, 0x02, 0x41, 0xA0, 0x03, 0x02, 0x01,
    0x02, 0x02, 0x14, 0x5E, 0x71, 0x6E, 0x37, 0x52, 0x2B, 0xE8, 0x4C, 0xCA,
    0xFE, 0x7D, 0xDC, 0xC5, 0xE4, 0x6D, 0x19, 0xE9, 0x3A, 0x69, 0x0B, 0x30,
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    0xE9, 0x13, 0x25, 0xA0, 0x8C, 0x1F, 0xB5, 0x87, 0x3B
};

static const br_x509_certificate CHAIN[] = {
    { (unsigned char *)CERT0, sizeof CERT0 }
};
static const unsigned char RSA_P[] = {
    0xC4, 0xFF, 0x2C, 0x25, 0x83, 0xED, 0x46, 0xD2, 0x01, 0xED, 0x56, 0x19,
    0xCD, 0xA1, 0x9E, 0xED, 0x33, 0x2A, 0x08, 0xCA, 0x34, 0xD9, 0x9B, 0xB6,
    0x8A, 0x86, 0x48, 0xF5, 0x10, 0x43, 0xEC, 0x93, 0x97, 0xE4, 0x75, 0xE3,
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    0x8C, 0x6E, 0x5F, 0x66, 0xD8, 0xFD, 0x67, 0x1F
};

static const unsigned char RSA_Q[] = {
    0xC0, 0x43, 0x06, 0x27, 0xE5, 0x36, 0xCB, 0x78, 0xC2, 0x8A, 0xEC, 0x48,
    0x1D, 0x42, 0xE2, 0x08, 0x0E, 0x1B, 0xD9, 0x94, 0xAC, 0xE1, 0xE4, 0x8A,
    0x09, 0xE3, 0x11, 0x02, 0xA3, 0x4D, 0xD4, 0xF1, 0xA7, 0xEA, 0x04, 0xB7,
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    0x5A, 0xF7, 0x54, 0xAA, 0xDD, 0x03, 0x96, 0x3D
};

static const unsigned char RSA_DP[] = {
    0x9B, 0x1F, 0x2C, 0x0E, 0x26, 0x82, 0x73, 0x1F, 0xEF, 0x70, 0x8A, 0x3A,
    0x2B, 0x58, 0x37, 0x23, 0x25, 0x04, 0xD6, 0x83, 0x13, 0x76, 0xBF, 0x4C,
    0xD0, 0x6B, 0xC9, 0x8B, 0x5F, 0xD1, 0x7C, 0xBB, 0x04, 0x02, 0x5C, 0x6A,
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    0x6B, 0xCD, 0x85, 0xC6, 0x20, 0xDB, 0xF9, 0x95
};

static const unsigned char RSA_DQ[] = {
    0x17, 0xE9, 0x7E, 0x1F, 0x82, 0x23, 0xA1, 0x84, 0xE0, 0x75, 0x54, 0xD3,
    0xD7, 0x47, 0xD5, 0x42, 0xF9, 0x36, 0x3F, 0x86, 0x7D, 0x46, 0x0F, 0x1D,
    0x98, 0x03, 0x34, 0xBF, 0x66, 0x3E, 0x2C, 0xE8, 0xED, 0x60, 0x6E, 0xBB,
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    0x29, 0x85, 0x2F, 0x73, 0x9C, 0xCF, 0x70, 0x65
};

static const unsigned char RSA_IQ[] = {
    0x10, 0x67, 0xDE, 0x84, 0x43, 0x14, 0x5C, 0xD4, 0xA5, 0xCB, 0xAC, 0x51,
    0xAA, 0x65, 0x72, 0xF7, 0x6C, 0x0C, 0x59, 0x91, 0x3B, 0x68, 0x96, 0x13,
    0x3D, 0x16, 0xDF, 0x99, 0x3A, 0x69, 0xA7, 0x04, 0xF0, 0xBC, 0x03, 0x1A,
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    0x26, 0x67, 0x2E, 0x5E, 0x71, 0xE0, 0x8C, 0x4E
};

static const br_rsa_private_key RSA = {
    2048,
    (unsigned char *)RSA_P, sizeof RSA_P,
    (unsigned char *)RSA_Q, sizeof RSA_Q,
    (unsigned char *)RSA_DP, sizeof RSA_DP,
    (unsigned char *)RSA_DQ, sizeof RSA_DQ,
    (unsigned char *)RSA_IQ, sizeof RSA_IQ
};


template <class BaseT>
struct ssl_wrapper : public tos::self_pointing<ssl_wrapper<BaseT>>
{
public:
    ssl_wrapper(tos::tcp_stream<tos::esp82::tcp_endpoint>& base) : m_base(base) {
        br_ssl_client_init_full(&sc, &xc, TAs, 1);
        br_ssl_engine_set_buffer(&sc.eng, iobuf, sizeof iobuf, 1);
        tos_debug_print("err %d\n", int(br_ssl_engine_last_error(&sc.eng)));

        if (!br_ssl_client_reset(&sc, nullptr, 0))
        {
            tos_debug_print("ssl_reset failed\n");
        }

        br_ssl_client_set_single_rsa(&sc, CHAIN, 1, &RSA, br_rsa_pkcs1_sign_get_default());

        br_sslio_init(&ioc, &sc.eng, sock_read, &m_base, sock_write, &m_base);
    }

    size_t write(tos::span<const char> buf)
    {
        auto res = br_sslio_write_all(&ioc, buf.data(), buf.size());
        if (res != 0) {
            tos_debug_print("err %d %d\n", res, int(br_ssl_engine_last_error(&sc.eng)));
            return 0;
        }
        br_sslio_flush(&ioc);
        return buf.size();
    }

    tos::expected<tos::span<char>, int> read(tos::span<char> buf)
    {
        auto len = br_sslio_read(&ioc, buf.data(), buf.size());
        if (len == -1)
        {
            tos_debug_print("errr %d\n", int(br_ssl_engine_last_error(&sc.eng)));
            return tos::unexpected(br_ssl_engine_last_error(&sc.eng));
            // error
        }
        return buf.slice(0, len);
    }

private:

    tos::tcp_stream<tos::esp82::tcp_endpoint>& m_base;
};

void ICACHE_FLASH_ATTR task() {
    using namespace tos::tos_literals;

    auto usart = open(tos::devs::usart<0>, tos::uart::default_9600);

    tos::print(usart, "\n\n\n\n\n\n");
    tos::println(usart, tos::platform::board_name);
    tos::println(usart, tos::vcs::commit_hash);

    auto w = open(tos::devs::wifi<0>);
    conn:

    auto res = w.connect("mayhem", "z00mz00m");
    tos::println(usart, "connected?", bool(res));
    if (!res) goto conn;

    with(std::move(res), [&](tos::esp82::wifi_connection &conn) ICACHE_FLASH_ATTR {
        conn.wait_for_dhcp();

        with(conn.get_addr(), [&](auto &addr) {
            tos::println(usart, "ip:", addr.addr[0], addr.addr[1], addr.addr[2], addr.addr[3]);
        }, tos::ignore);
        lwip_init();

        sntp_set_timezone(0);
        tos::ipv4_addr_t taddr { 128, 111, 1, 5 };
        ip_addr_t addr;
        memcpy(&addr.addr, &taddr, 4);
        sntp_setserver(0, &addr);
        sntp_init();

        for (int j = 0; j < 25'000; ++j) {
            vecs.push(do_sntp_request());
            auto b = tos::high_resolution_clock::now();
            with(tos::esp82::connect(conn, {{52, 24, 22, 85}}, {8883}),
                 [&](tos::esp82::tcp_endpoint &conn) {
                     tos::tcp_stream<tos::esp82::tcp_endpoint> stream{std::move(conn)};
                     ssl_wrapper<decltype((stream))> ssl(stream);
                     net_facade<decltype((ssl))> net{ssl};

                     auto client = new MQTT::Client<decltype(net), timer_facade, 512>(net);
                     MQTTPacket_connectData data = MQTTPacket_connectData_initializer;
                     data.MQTTVersion = 3;
                     data.clientID.cstring = (char *) "tos-client";
                     auto rc = client->connect(data);

                     if (rc != 0) {
                         tos::println(usart, "rc from MQTT connect is", rc);
                         return;
                     }

                     tos::println(usart, "MQTT connected");

                     if (stream.disconnected()) {
                         tos::println(usart, "disc");
                         return;
                     }

                     auto res = handle_samples(*client);
                     tos::println(usart, "res", res, j * 1000, int(system_get_free_heap_size()));
                     tos::this_thread::yield();

                     delete client;
                 }, [&](auto &) {
                    tos::println(usart, "couldn't connect");
                });
            auto l = tos::high_resolution_clock::now() - b;
            tos::println(usart, "dur", int(l.count()));
        }

        tos::println(usart, "done");
    }, [&](auto &) {
        tos::println(usart, "uuuh, shouldn't have happened!");
    });
}

tos::stack_storage<1024 * 6> stak;
void tos_main() {
    tos_debug_print("main stack: %p\n", read_sp());
    tos::launch(stak, task);
}